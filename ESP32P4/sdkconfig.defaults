## ESP32P4/sdkconfig.defaults
```kconfig
# ===== LVGL configuration for the spot-welder UI (ui.cpp) =====
# NOTE: these defaults only apply to a FRESH config. If you have already built
# once, the generated `sdkconfig` already has the old values and will WIN over
# this file. Do NOT just delete `sdkconfig` (that would also wipe your PSRAM /
# flash-size / target settings, which live only in `sdkconfig`). Instead, apply
# the LVGL changes below via:  idf.py menuconfig
#   Component config -> LVGL configuration -> Memory Settings
#     -> set the allocator to "C library's malloc/free"  (LV_USE_CLIB_MALLOC)
# then: idf.py -p COM6 build flash monitor

# Color depth must match the RGB panel (RGB565)
CONFIG_LV_COLOR_DEPTH_16=y

# Fonts used by ui.cpp
CONFIG_LV_FONT_MONTSERRAT_14=y
CONFIG_LV_FONT_MONTSERRAT_16=y
CONFIG_LV_FONT_MONTSERRAT_18=y
CONFIG_LV_FONT_MONTSERRAT_20=y
CONFIG_LV_FONT_MONTSERRAT_24=y
CONFIG_LV_FONT_MONTSERRAT_48=y
CONFIG_LV_FONT_DEFAULT_MONTSERRAT_14=y

# Widgets / extras used by ui.cpp
CONFIG_LV_USE_TABVIEW=y
CONFIG_LV_USE_SPINBOX=y
CONFIG_LV_USE_BAR=y
CONFIG_LV_USE_QRCODE=y

# ===== LVGL memory allocator =====
# The 5-tab 800x480 UI needs far more than the 64 KB builtin LVGL pool. When
# the builtin pool overflows mid-build, lv_malloc() fails, LV_ASSERT_MALLOC
# spins forever, and the task watchdog reboots the chip (~5 s after touch init).
# Use the C-library allocator instead so LVGL draws from the system heap, which
# already includes the 32 MB PSRAM pool (see "Adding pool of 32768K of PSRAM
# memory to heap allocator" in the boot log). This eliminates the OOM crash.
CONFIG_LV_USE_CLIB_MALLOC=y
# (LV_MEM_SIZE_KILOBYTES only applies to the builtin allocator, which is now
#  disabled, so it is intentionally omitted.)
#
# --- PSRAM initialization (ESP32-P4 requires external PSRAM for display) ---
# The CrowPanel P4 has 32 MB of external PSRAM (Octal-SPI mode). This is
# ESSENTIAL for the 800x480 RGB LCD framebuffers + LVGL UI memory.
CONFIG_SPIRAM=y
# Octal-SPI PSRAM mode (8-bit data bus for higher bandwidth)
CONFIG_SPIRAM_MODE_OCT=y
# PSRAM clock speed: 200 MHz is the default for P4 (conservative, stable)
CONFIG_SPIRAM_SPEED_200M=y
# PSRAM size (CrowPanel has 32 MB)
CONFIG_SPIRAM_SIZE=33554432
#
# --- PSRAM allocation strategy (fixes WiFi-induced glitching) ---
# LVGL's draw buffers (moved to PSRAM in welder_main.cpp) free ~150 KB of
# internal RAM, but LVGL objects themselves are still malloc'd and can exhaust
# internal RAM when WiFi is active. Route large allocations (>= 16 KB) to PSRAM
# automatically, keeping small/DMA-critical allocations (WiFi, lwIP, drivers)
# in internal RAM. This eliminates the screen glitching that appeared when the
# WiFi stack came up and competed for internal RAM.
CONFIG_SPIRAM_USE_MALLOC=y
CONFIG_SPIRAM_MALLOC_ALWAYSINTERNAL=16384
# Explicitly keep WiFi/lwIP buffers in internal RAM (they need it for DMA).
CONFIG_SPIRAM_TRY_ALLOCATE_WIFI_LWIP=y

# ===== RTOS tick rate =====
# Run the FreeRTOS tick at 1000 Hz (1 ms/tick) instead of the 100 Hz default.
# The LVGL task loops with vTaskDelay(pdMS_TO_TICKS(5)); at 100 Hz that rounds
# DOWN to 0 ticks, so vTaskDelay(0) never blocks — the lower-priority IDLE0
# task on CPU0 is starved, the task watchdog is never fed, and it trips
# repeatedly (the "IDLE0 (CPU 0)" watchdog crash). At 1000 Hz the 5 ms delay
# blocks for a real 5 ticks, IDLE0 runs, and LVGL also gets finer timing for
# smoother rendering. (The code in welder_main.cpp also clamps the delay to a
# minimum of 1 tick as a belt-and-suspenders guard regardless of this setting.)
CONFIG_FREERTOS_HZ=1000

# ===== Runtime: task watchdog =====
# Generous timeout to survive the first full-screen software paint of the
# large 5-tab 800x480 UI at boot. With the LVGL task now yielding correctly
# (see FREERTOS_HZ above + the 1-tick delay clamp) the watchdog should never
# trip in steady state.
CONFIG_ESP_TASK_WDT_TIMEOUT_S=60
# NOTE: do NOT enable CONFIG_ESP_SYSTEM_USE_FRAME_POINTER here. It is applied to
# the bootloader build too and pushes the bootloader binary past its 24 KB cap
# (build error: "Bootloader binary size 0x61a0 ... too large"). It also adds
# per-function runtime overhead, which slows the already-heavy software render.
# Apply the watchdog timeout via: idf.py menuconfig
#   Component config -> ESP System Settings
#     -> Task Watchdog timeout period (seconds)        = 30

# ===== WiFi / radio (ESP32-P4 + external XIAO ESP32-C6) =====
# The ESP32-P4 has NO native WiFi radio. WiFi is provided by an EXTERNAL Seeed
# XIAO ESP32-C6 connected via SPI to the CrowPanel J7 wireless module header.
# This frees the P4's SDMMC controller for the SD card (avoiding the SDIO conflict
# with the onboard C6). The standard esp_wifi API in wifi_bridge.cpp works
# transparently through esp_hosted / esp_wifi_remote (main/idf_component.yml).
#
# --- ESP-Hosted SPI transport pins (J7 header → XIAO C6 slave) ---
# CRITICAL: These pins connect the P4 SPI master to the XIAO C6 SPI slave via
# the J7 wireless module header. The XIAO slave firmware (xiao-c6-slave) MUST
# be flashed with matching pin configuration (see INTEGRATION_GUIDE.md).
#
# Physical wiring (verified against CrowPanel V1.0 schematic):
#   Signal      | P4 GPIO | J7 Pin | XIAO Pin | XIAO GPIO
#   ------------|---------|--------|----------|----------
#   MOSI        | 48      | —      | D10      | 18
#   MISO        | 47      | —      | D9       | 20
#   CLK         | 26      | —      | D8       | 19
#   CS          | 29      | —      | D2       | 2
#   Handshake   | 30      | —      | D1       | 1
#   Data Ready  | 31      | —      | D7       | 17
#   Power       | —       | 3V3    | 3V3      | —
#   Ground      | —       | GND    | GND      | —
#
# ⚠️  DO NOT connect XIAO D4/D5 (GPIO22/23) — they are physically wired to the
#     P4's I2C bus (GT911 touch + STC8 backlight controller).
#
# These CONFIG_ESP_HOSTED_* symbols are provided by the esp_hosted managed
# component (declared in main/idf_component.yml).
CONFIG_ESP_HOSTED_ENABLED=y
# Transport: SPI only (not SDIO, not UART, not SPI-HD)
CONFIG_ESP_HOSTED_SPI_HOST_INTERFACE=y
# CONFIG_ESP_HOSTED_SDIO_HOST_INTERFACE is not set
# CONFIG_ESP_HOSTED_SPI_HD_HOST_INTERFACE is not set
# CONFIG_ESP_HOSTED_UART_HOST_INTERFACE is not set
CONFIG_ESP_HOSTED_IDF_SLAVE_TARGET="esp32c6"
# Select co-processor target (enables C6-specific config)
CONFIG_ESP_HOSTED_CP_TARGET_ESP32C6=y
# No dev board preset (custom J7 wiring)
CONFIG_ESP_HOSTED_P4_DEV_BOARD_NONE=y
# SPI Controller (HSPI = SPI1)
CONFIG_ESP_HOSTED_SPI_HSPI=y
CONFIG_ESP_HOSTED_SPI_CONTROLLER=1
# SPI Mode 3 (CPOL=1, CPHA=1) - required for non-ESP32 slaves
CONFIG_ESP_HOSTED_SPI_PRIV_MODE_3_ESP32XX=y
CONFIG_ESP_HOSTED_SPI_MODE=3
# SPI Master GPIOs (P4 side, J7 header)
CONFIG_ESP_HOSTED_SPI_HSPI_GPIO_MOSI=48
CONFIG_ESP_HOSTED_SPI_HSPI_GPIO_MISO=47
CONFIG_ESP_HOSTED_SPI_HSPI_GPIO_CLK=26
CONFIG_ESP_HOSTED_SPI_HSPI_GPIO_CS=29
CONFIG_ESP_HOSTED_SPI_GPIO_HANDSHAKE=30
CONFIG_ESP_HOSTED_SPI_GPIO_DATA_READY=31
# Reset: use XIAO's EN pin (no dedicated P4 GPIO needed)
CONFIG_ESP_HOSTED_SPI_GPIO_RESET_SLAVE=-1
CONFIG_ESP_HOSTED_SPI_RESET_ACTIVE_HIGH=y
# Handshake/DataReady polarity
CONFIG_ESP_HOSTED_HS_ACTIVE_HIGH=y
CONFIG_ESP_HOSTED_DR_ACTIVE_HIGH=y
# SPI frequency: 10 MHz.
# IMPORTANT: The XIAO C6 slave pins (GPIO 18/19/20/2) are routed through the
# GPIO MATRIX, not the dedicated FSPI IOMUX pins. SPI slave via GPIO matrix has
# an input-delay limit and cannot reliably sample at 20 MHz — the link starts
# (slave logs "ESPInit") then corrupts with "rx_pkt len+offset[131070]>max[1600]"
# (an all-0xFF / idle-high read). 10 MHz is within the GPIO-matrix slave limit.
# If still unstable, drop further to 5 MHz.
CONFIG_ESP_HOSTED_SPI_FREQ_ESP32C6=10
#
# Boot log should now print: SPI transport initialized, MOSI[48] MISO[47] CLK[26]
# CS[29] HS[30] DR[31]. If the XIAO C6 doesn't respond:
#  1. Verify XIAO slave firmware is flashed (see xiao-c6-slave/BUILD_INSTRUCTIONS.md)
#  2. Check wiring: all 6 signal pins + 3V3 + GND connected to J7 header
#  3. Verify XIAO boots (serial monitor shows "SPI slave initialized")
#
# wifi_stack_init() treats a failed link as NON-FATAL so the welder UI keeps
# running either way (with WiFi disabled).
#
# WiFi station+AP (provisioning) mode is enabled at runtime by wifi_bridge.cpp;
# buffer settings use ESP-IDF defaults — tune via menuconfig if needed.

# ===== Chip Revision =====
# Allow early P4 silicon (rev v1.x). Default in IDF v6.0.1 is v3.0+ (ECO5),
# which causes flash error: "bootloader requires chip revision [v3.1 - v3.99]".
# Your P4 is rev v1.3, so we set minimum to v0.0 to cover all revisions.
CONFIG_ESP32P4_REV_MIN_0=y

# ===== Flash Size =====
# CrowPanel P4 has 16 MB flash (verify via: esptool.py --port COM6 flash_id).
# The default 2 MB setting in a fresh sdkconfig is wrong and causes partition
# table overflow errors when the factory app is 2 MB.
CONFIG_ESPTOOLPY_FLASHSIZE_16MB=y

# ===== Partition Table =====
# The full WiFi provisioning + HTTP server + captive portal + mDNS pushed the
# binary past the default 1 MB factory partition (actual size ~1.27 MB). Use a
# custom partition table (partitions.csv) with a 2 MB factory app.
CONFIG_PARTITION_TABLE_CUSTOM=y
CONFIG_PARTITION_TABLE_CUSTOM_FILENAME="partitions.csv"

# ===== RGB LCD anti-glitch / anti-drift (fixes shifting lines under WiFi load) =====
# Symptom: with WiFi active, horizontal lines on the 800x480 RGB panel drift /
# shift. Root cause: the RGB peripheral streams the PSRAM framebuffer through an
# internal-RAM bounce buffer via GDMA. When WiFi DMA + cache misses steal PSRAM
# bandwidth, the bounce buffer underruns and the scan-out loses alignment.
#
# NOTE: CONFIG_LCD_RGB_RESTART_IN_VSYNC was tried and made the drift WORSE in
# our single-framebuffer partial-render setup (it forces a hard DMA realignment
# mid-scanout that is visible as a jump). It is intentionally NOT set. The real
# cure is the VSYNC-synced double framebuffer in welder_main.cpp (num_fbs=2 +
# avoid-tearing draw), matching the proven Elecrow WiFi+display reference.
#
# Keep the GDMA control path and ISR handler in IRAM so the bounce-buffer
# refill keeps running even when the flash/PSRAM cache is briefly disabled
# (e.g. during WiFi/NVS flash writes). Matches the reference (Lesson16).
CONFIG_GDMA_CTRL_FUNC_IN_IRAM=y
CONFIG_GDMA_ISR_HANDLER_IN_IRAM=y
CONFIG_GDMA_OBJ_DRAM_SAFE=y

# ===== XIP from PSRAM (fixes WHOLE-SCREEN glitch during OTA / flash writes) =====
# Symptom: during a firmware OTA (a ~1.3 MB write to the SPI flash) the entire
# RGB panel tears/glitches, not just the progress bar. The full-screen progress
# popup only MASKS it (fewer edges = less visible tearing), it does not fix it.
#
# Root cause: the 800x480 framebuffer lives in PSRAM and is streamed to the RGB
# peripheral through an internal-RAM bounce buffer. The bounce-buffer refill
# ISR must read the PSRAM framebuffer via the data cache. While ESP-IDF writes
# to the SPI flash it DISABLES the cache; the bounce buffer can no longer refill
# and the scan-out loses data => whole-screen corruption for the whole write.
# The GDMA-in-IRAM settings above only survive the BRIEF cache stalls from
# WiFi/NVS writes; a multi-second OTA write overwhelms them.
#
# Fix: execute code (.text) and read-only data (.rodata) from PSRAM instead of
# flash. The ESP32-P4 puts flash and PSRAM on SEPARATE SPI buses, so with XIP
# the data cache stays ALIVE during flash writes and the LCD keeps streaming
# normally. This is Espressif's documented cure for LCD glitching during flash
# ops (see external-ram.html "XiP from PSRAM").
#
# Notes / guard rails (per Espressif docs + known P4 OTA issues):
#  - CONFIG_SPIRAM_MALLOC_ALWAYSINTERNAL must stay non-zero (we keep 16384 above)
#    so DMA-critical buffers remain in internal RAM when the cache is disabled.
#  - Do NOT enable CONFIG_SPIRAM_ECC_ENABLE — it is known to break OTA on the P4
#    (it is off by default; just don't turn it on).
CONFIG_SPIRAM_XIP_FROM_PSRAM=y
```
